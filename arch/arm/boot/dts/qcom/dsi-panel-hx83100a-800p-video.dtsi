/* Copyright (c) 2015, The Linux Foundation. All rights reserved.
 *
 * This program is free software; you can redistribute it and/or modify
 * it under the terms of the GNU General Public License version 2 and
 * only version 2 as published by the Free Software Foundation.
 *
 * This program is distributed in the hope that it will be useful,
 * but WITHOUT ANY WARRANTY; without even the implied warranty of
 * MERCHANTABILITY or FITNESS FOR A PARTICULAR PURPOSE.  See the
 * GNU General Public License for more details.
 */

&mdss_mdp {
	dsi_boyi_hx83100a_800p_video: qcom,mdss_dsi_boyi_hx83100a_800p_video {
		qcom,mdss-dsi-panel-name = "hx83100a 800p video mode dsi panel";
		qcom,mdss-dsi-panel-controller = <&mdss_dsi0>;
		qcom,mdss-dsi-panel-type = "dsi_video_mode";
		qcom,mdss-dsi-panel-destination = "display_2";
		qcom,mdss-dsi-panel-framerate = <60>;
		qcom,mdss-dsi-virtual-channel-id = <0>;
		qcom,mdss-dsi-stream = <0>;
		qcom,mdss-dsi-panel-width = <800>;
		qcom,mdss-dsi-panel-height = <1280>;
		qcom,mdss-dsi-h-front-porch = <40>;
		qcom,mdss-dsi-h-back-porch = <40>;
		qcom,mdss-dsi-h-pulse-width = <40>;
		qcom,mdss-dsi-h-sync-skew = <0>;
		qcom,mdss-dsi-v-back-porch = <8>;
		qcom,mdss-dsi-v-front-porch = <412>;
		qcom,mdss-dsi-v-pulse-width = <4>;
		qcom,mdss-dsi-h-left-border = <0>;
		qcom,mdss-dsi-h-right-border = <0>;
		qcom,mdss-dsi-v-top-border = <0>;
		qcom,mdss-dsi-v-bottom-border = <0>;
		qcom,mdss-dsi-bpp = <24>;
		qcom,mdss-dsi-color-order = "rgb_swap_rgb";
		qcom,mdss-dsi-underflow-color = <0xff>;
		qcom,mdss-dsi-border-color = <0>;
		qcom,mdss-dsi-on-command = [
		/*	39 01 00 00 00 00 04
                    B9 83 10 0A 
            39 01 00 00 00 00 07
                    BA 63 13 60 3B 
                    B2 80
            39 01 00 00 00 00 0C 
                    B1 08 63 23 A1 
                    D9 22 22 4E EE 
                    3F 7F
            39 01 00 00 00 00 02 
                    BD 01 
            39 01 00 00 00 00 0B
                    B1 D8 C0 28 88 
                    88 22 7A 52 15 
                    12 
            39 01 00 00 00 00 02
                    BD 00 
            39 01 00 00 00 00 13
                    B2 00 00 64 0A
                    94 6F 0A 94 6F 
                    00 00 00 00 15 
                    31 02 02 42
            39 01 00 00 00 00 0E
                    B4 00 FF 4B 3C 
                    4B 3C 3C 3C 01 
                    46 01 46 20
            39 01 00 00 00 00 04 
                    B6 A5 A5 00
            39 01 00 00 00 00 02
                    CC 02
            39 01 00 00 00 00 1F
                    D3 10 00 00 3C 
                    1D 04 00 32 10 
                    05 10 06 54 15
                    0B 15 0C 00 00 
                    00 00 00 47 44 
                    07 07 4B 00 00
                    00
            39 01 00 00 00 00 29
                    D5 18 18 18 18 
                    18 18 18 18 18 
                    18 18 18 18 18 
                    18 18 26 27 18 
                    18 24 25 1A 1A 
                    1B 1B 0A 0B 08 
                    09 06 07 04 05 
                    02 03 00 01 20 
                    21 
            39 01 00 00 00 00 29
                    D6 18 18 18 18 
                    18 18 18 18 18 
                    18 18 18 18 18 
                    18 18 27 26 18 
                    18 21 20 1A 1A 
                    1B 1B 01 00 03 
                    02 05 04 07 06 
                    09 08 0B 0A 25 
                    24 
            39 01 00 00 00 00 15
                    E7 20 28 14 AF 
                    10 AF 20 3C 0A 
                    D1 10 7B 32 32 
                    04 04 00 0F 32 
                    32
            39 01 00 00 00 00 02
                    BD 01 
            39 01 00 00 00 00 02
                    E7 01
            39 01 00 00 00 00 02
                    BD 00 
            39 01 00 00 00 00 3B
                    E0 0C 18 24 2B 
                    2F 33 36 35 6C 
                    7B 8A 89 91 A1 
                    A3 A6 B1 B3 AD 
                    B9 C7 62 5F 61 
                    64 67 6D 70 6E 
                    0C 18 24 2B 2F 
                    33 36 35 6C 7B 
                    8A 89 91 A1 A3 
                    A6 B1 B3 AD B9 
                    C7 62 5F 61 64 
                    67 6D 70 6E 
            39 01 00 00 00 00 07
                    C0 01 10 00 34 
                    33 33
            39 01 00 00 00 00 07
                    CB 0F 00 60 04 
                    24 41
            39 01 00 00 00 00 02
                    BD 02 
            39 01 00 00 00 00 08
                    D3 01 11 01 01 
                    E6 E6 E6
            39 01 00 00 00 00 02
                    BD 00 
            39 01 00 00 00 00 02
                    C6 FC */
            39 01 00 00 78 00 02 11 00
			39 01 00 00 0A 00 02 29 00
           // 39 01 00 00 00 00 02 51 FF 
            39 01 00 00 00 00 08
                    C9 1F 00 23 1E 
                    81 1E 00
		    39 01 00 00 00 00 02 53 24
            39 01 00 00 00 00 02 55 01 
            
            
];
		qcom,mdss-dsi-off-command = [05 01 00 00 96 00 02 28 00
					     05 01 00 00 00 00 02 10 00];
		qcom,mdss-dsi-on-command-state = "dsi_lp_mode";
		qcom,mdss-dsi-off-command-state = "dsi_hs_mode";
		qcom,mdss-dsi-h-sync-pulse = <1>;
		qcom,mdss-dsi-traffic-mode = "burst_mode";
		qcom,mdss-dsi-lane-map = "lane_map_0123";
		qcom,mdss-dsi-bllp-eof-power-mode;
		qcom,mdss-dsi-bllp-power-mode;
		qcom,mdss-dsi-lane-0-state;
		qcom,mdss-dsi-lane-1-state;
		qcom,mdss-dsi-lane-2-state;
		qcom,mdss-dsi-lane-3-state;
		qcom,mdss-dsi-panel-timings = [9B 22 18 00 4A 4E 1C 26 1D 03 04 00];
		qcom,mdss-dsi-t-clk-post = <0x04>;
		qcom,mdss-dsi-t-clk-pre = <0x1f>;
		qcom,mdss-dsi-bl-min-level = <1>;
		qcom,mdss-dsi-bl-max-level = <255>;
        qcom,panel-supply-entries = <&dsi_panel_pwr_supply>;
		qcom,mdss-dsi-dma-trigger = "trigger_sw";
		qcom,mdss-dsi-mdp-trigger = "none";
		qcom,mdss-dsi-bl-pmic-control-type = "bl_ctrl_dcs";
        	//qcom,mdss-dsi-bl-pmic-pwm-frequency = <100>;
		//qcom,mdss-dsi-bl-pmic-bank-select = <0>;
		//qcom,mdss-dsi-pwm-gpio = <&pm8937_gpios 2 0>;
        qcom,mdss-dsi-reset-sequence = <1 10>, <0 5>, <1 50>;
        qcom,mdss-dsi-lp11-init;
		qcom,mdss-dsi-post-init-delay = <1>;
		
      
	};
};
